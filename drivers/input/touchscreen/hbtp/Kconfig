## drivers/input/touchscreen/hbtp/Kconfig
```kconfig
#
# Host Based Touch Processing driver
# For QTi Improvetouch devices
#

config INPUT_HBTP_INPUT
	tristate "HBTP input driver support"
	help
	  This option enables an input driver for the host based touch
	  processing.

	  Say Y to enable HBTP input driver.

	  To compile this driver as a module, choose M here: the
	  module will be called hbtp_input.
```
